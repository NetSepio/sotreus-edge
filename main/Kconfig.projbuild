## main/Kconfig.projbuild
```kconfig
menu "Sotreus Edge"

    config EDGE_OLED_ENABLE
        bool "Use the on-board SSD1306 OLED"
        default y

    config EDGE_BLE_PRIVACY
        bool "Advertise with a resolvable private address (rotating)"
        default y
        help
            The Edge's Bluetooth address changes over time so it cannot be
            followed by its address. Bonded phones still resolve it.

    config EDGE_AP_CHANNEL
        int "Channel used by the Edge's own Wi-Fi access point"
        range 1 11
        default 6

    config EDGE_BATT_DIVIDER_X1000
        int "Battery divider ratio x1000 (Heltec V3: 390k/100k = 4900)"
        default 4900

    choice EDGE_BATT_CTRL
        prompt "Battery measurement enable level on GPIO37"
        default EDGE_BATT_CTRL_AUTO
        config EDGE_BATT_CTRL_AUTO
            bool "Detect at boot"
        config EDGE_BATT_CTRL_LOW
            bool "Active low (board rev 3.0 / 3.1)"
        config EDGE_BATT_CTRL_HIGH
            bool "Active high (board rev 3.2)"
    endchoice

    config EDGE_LORA_TCXO_MV
        int "SX1262 TCXO voltage on DIO3 (mV, 0 = crystal)"
        default 1800

    config EDGE_LORA_MAX_POWER_DBM
        int "Highest LoRa transmit power the board allows (dBm)"
        range 2 22
        default 22

endmenu
```

## sdkconfig.defaults
```kconfig
# --- Target / flash ---------------------------------------------------------
CONFIG_IDF_TARGET="esp32s3"
CONFIG_ESPTOOLPY_FLASHSIZE_8MB=y
CONFIG_ESPTOOLPY_FLASHMODE_QIO=y
CONFIG_PARTITION_TABLE_CUSTOM=y
CONFIG_PARTITION_TABLE_CUSTOM_FILENAME="partitions.csv"
CONFIG_COMPILER_OPTIMIZATION_SIZE=y

# --- System -------------------------------------------------------------------
CONFIG_FREERTOS_HZ=1000
CONFIG_ESP_MAIN_TASK_STACK_SIZE=4096
CONFIG_ESP_SYSTEM_EVENT_TASK_STACK_SIZE=4096
CONFIG_FREERTOS_USE_TRACE_FACILITY=y
CONFIG_BOOTLOADER_APP_ROLLBACK_ENABLE=y
CONFIG_ESP_COREDUMP_ENABLE_TO_FLASH=y

# --- Bluetooth (NimBLE: peripheral for the app link, observer for sensing) ----
CONFIG_BT_ENABLED=y
CONFIG_BT_NIMBLE_ENABLED=y
CONFIG_BT_NIMBLE_ROLE_PERIPHERAL=y
CONFIG_BT_NIMBLE_ROLE_BROADCASTER=y
CONFIG_BT_NIMBLE_ROLE_OBSERVER=y
CONFIG_BT_NIMBLE_ROLE_CENTRAL=n
CONFIG_BT_NIMBLE_MAX_CONNECTIONS=2
CONFIG_BT_NIMBLE_MAX_BONDS=4
CONFIG_BT_NIMBLE_NVS_PERSIST=y
CONFIG_BT_NIMBLE_SM_LEGACY=n
CONFIG_BT_NIMBLE_SM_SC=y
CONFIG_BT_NIMBLE_ATT_PREFERRED_MTU=512
CONFIG_BT_NIMBLE_MSYS_1_BLOCK_COUNT=24
CONFIG_BT_NIMBLE_HOST_TASK_STACK_SIZE=5120
CONFIG_BT_NIMBLE_SVC_GAP_DEVICE_NAME="Sotreus Edge"
CONFIG_BT_NIMBLE_GAP_DEVICE_NAME_MAX_LEN=32
CONFIG_BT_NIMBLE_LOG_LEVEL_WARNING=y
CONFIG_BT_NIMBLE_EXT_ADV=n

# --- Wi-Fi --------------------------------------------------------------------
CONFIG_ESP_WIFI_SOFTAP_SUPPORT=y
CONFIG_ESP_WIFI_STATIC_RX_BUFFER_NUM=6
CONFIG_ESP_WIFI_DYNAMIC_RX_BUFFER_NUM=20
CONFIG_ESP_WIFI_DYNAMIC_TX_BUFFER_NUM=20
CONFIG_ESP_COEX_SW_COEXIST_ENABLE=y
CONFIG_LWIP_MAX_SOCKETS=16

# --- HTTP server --------------------------------------------------------------
CONFIG_HTTPD_WS_SUPPORT=y
CONFIG_HTTPD_MAX_REQ_HDR_LEN=1024
CONFIG_HTTPD_MAX_URI_LEN=512

# --- Logging ------------------------------------------------------------------
CONFIG_LOG_DEFAULT_LEVEL_INFO=y
```
